## boards/holyiot/holyiot_21014/Kconfig.defconfig
```kconfig
# Holyiot 21014 board configuration

# Copyright (c) 2018 Nordic Semiconductor ASA
# SPDX-License-Identifier: Apache-2.0

if BOARD_HOLYIOT_21014

config BOARD
    default "holyiot_21014"

endif
```

## boards/holyiot/holyiot_21014/Kconfig.holyiot_21014
```kconfig
# Holyiot 21014 board configuration

# Copyright (c) 2018 Nordic Semiconductor ASA
# SPDX-License-Identifier: Apache-2.0

config BOARD_HOLYIOT_21014
    bool "Holyiot 21014"
    select SOC_NRF52810_QFAA
```
